/**************************************************************************/
/*!
Phantom Driver using I2C for analog signal generation

Based on example from Adafruit MCP4725

Updated October 23rd to have a second lookup table for HPIs w 1/3 regular voltage.
*/
/**************************************************************************/
#include <Wire.h>
#include <Adafruit_MCP4725.h>
Adafruit_MCP4725 dac;

// Phantom driver settings
int numTrials = 3;
int ISI = 200; //time between activations, milliseconds
int switchingDelay = 1000; //time between switching from line to line, milliseconds
int outPin = 9;     // Start on pin 9 (relay 1)
                    // Note relays increment as outPin decrements
                    // D9 is Relay 1
                    // D2 is Relay 8
int lastPin = 2;    // Pin to end on (can be changed to send to less than 8 lines)

// Some system variables
int state = 0;      // Initial state for state machine
int trialIndex = 0; // Initial trial index

// Lookup table for inverted cosine wave (driver signal)
const PROGMEM uint16_t COS_Lookup_12bit[1280]=
{
0, 0, 0, 0, 0, 0, 0, 1, 1, 1, 2, 2,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 0 
};

const PROGMEM uint16_t COS_Lookup_12bit_thirdScale[1280]=
{
0, 0, 0, 0, 0, 0, 0, 0, 0, 0, 0, 0,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 0, 
};

void setup(void) {
  Serial.begin(9600);
  // Activate DAC and set output voltage to zero
  dac.begin(0x62);
  dac.setVoltage(0,false);
  // Setup digital lines and close all relays
  for (int p=2; p<10; p++) {
    pinMode(p,OUTPUT);
    digitalWrite(p,HIGH);
  }
}

void loop(void) {
  uint16_t i;

  // State 0: Activate one relay
  if (state == 0) {
    // Close all relays
    for (int p=9; p>1; p--) {
      digitalWrite(p,HIGH);
    }
    // Open one relay
    digitalWrite(outPin, LOW);
    outPin--;
    // Wait a bit for any settling after the relay switch
    delay(switchingDelay);     
    // Go to the next state
    state++;
  }

  // State 2: Send the driving signal
  if (state == 1) {
    // Push out the lookup table values to send the driving signal
    if (outPin > 4)  {
      for (i = 0; i < 1280; i++)
      {
        dac.setVoltage(pgm_read_word(&(COS_Lookup_12bit[i])), false);
      }
    }
    if (outPin < 5)  {
      for (i = 0; i < 1280; i++)
      {
        dac.setVoltage(pgm_read_word(&(COS_Lookup_12bit_thirdScale[i])), false);
      }
    }

    // If we're at the end of the signal
    if (i == 1280) {
      state++;            // Go to the next state
    }
  }

  // State 2: Delay before the next driver signal
  if (state == 2) {
    delay(ISI);
    trialIndex++;     // Incrememnt trial number
    // If we've sent the correct number of signals
    if (trialIndex == numTrials) {
      trialIndex = 0;     // Reset trial number
      // If we're not on the last relay
      if (outPin > lastPin-1) {
        state = 0;          // Go to the relay shift state
      } else {
        state = 3;          // Go to the end state
      }
    }
    // If we still have trials to send
    else {
      state = 1;          // Present the next driver signal
    }
  }

  // State 3: End state 
  if (state == 3) {
    // Close all relays
    for (int p=9; p>1; p--) {
      digitalWrite(p,HIGH);
    }
  }
}

